## bootstrap/independent-surface-runtime/configs/ordax_surface_defconfig
```kconfig
BR2_x86_64=y
BR2_TOOLCHAIN_BUILDROOT_MUSL=y
BR2_TOOLCHAIN_BUILDROOT_CXX=y
BR2_USE_WCHAR=y
BR2_ENABLE_LOCALE=y
BR2_SHARED_LIBS=y
BR2_CCACHE=y
BR2_CCACHE_USE_BASEDIR=y
BR2_INIT_NONE=y
BR2_PACKAGE_BUSYBOX=y
BR2_ROOTFS_DEVICE_CREATION_DYNAMIC_EUDEV=y
BR2_PACKAGE_EUDEV=y
BR2_PACKAGE_CA_CERTIFICATES=y
BR2_PACKAGE_PYTHON3=y
BR2_PACKAGE_PYTHON_GOBJECT=y
BR2_PACKAGE_MESA3D=y
BR2_PACKAGE_MESA3D_GALLIUM_DRIVER_SOFTPIPE=y
BR2_PACKAGE_MESA3D_OPENGL_EGL=y
BR2_PACKAGE_MESA3D_OPENGL_ES=y
BR2_PACKAGE_MESA3D_GBM=y
BR2_PACKAGE_LIBGTK3=y
BR2_PACKAGE_LIBGTK3_WAYLAND=y
BR2_PACKAGE_WEBKITGTK=y
BR2_PACKAGE_WEBKITGTK_WAYLAND=y
BR2_PACKAGE_WEBKITGTK_HTTPS=y
BR2_PACKAGE_WEBKITGTK_SANDBOX=y
BR2_PACKAGE_WEBKITGTK_MULTIMEDIA=y
BR2_PACKAGE_GSTREAMER1=y
BR2_PACKAGE_GSTREAMER1_INSTALL_TOOLS=y
BR2_PACKAGE_GST1_PLUGINS_BASE=y
BR2_PACKAGE_GST1_PLUGINS_GOOD=y
BR2_PACKAGE_GST1_PLUGINS_GOOD_PLUGIN_PULSE=y
BR2_PACKAGE_GST1_LIBAV=y
BR2_PACKAGE_PIPEWIRE=y
BR2_PACKAGE_PIPEWIRE_GSTREAMER=y
BR2_PACKAGE_PULSEAUDIO=y
BR2_PACKAGE_LUA=y
BR2_PACKAGE_LUA_5_4=y
BR2_PACKAGE_WIREPLUMBER=y
BR2_PACKAGE_DBUS=y
BR2_PACKAGE_XORG7=y
BR2_PACKAGE_XKEYBOARD_CONFIG=y
BR2_PACKAGE_XWAYLAND=y
BR2_PACKAGE_SEATD=y
BR2_PACKAGE_SEATD_DAEMON=y
BR2_PACKAGE_CAGE=y
BR2_PACKAGE_DEJAVU=y
BR2_PACKAGE_HICOLOR_ICON_THEME=y
BR2_PACKAGE_SHARED_MIME_INFO=y
BR2_TARGET_ROOTFS_TAR=y
# This artifact is a runtime payload mounted by the canonical portable boot flow.
# It deliberately contains no package manager and does not define another PID1.
```
